## boards/shields/easysplit/Kconfig.defconfig
```kconfig
if SHIELD_EASYSPLIT_LEFT

config ZMK_KEYBOARD_NAME
    default "EasySplit"

config ZMK_SPLIT_ROLE_CENTRAL
    default y

endif # SHIELD_EASYSPLIT_LEFT

if SHIELD_EASYSPLIT_LEFT || SHIELD_EASYSPLIT_RIGHT

config ZMK_SPLIT
    default y

endif # SHIELD_EASYSPLIT_LEFT || SHIELD_EASYSPLIT_RIGHT
```

## boards/shields/easysplit/Kconfig.shield
```kconfig
config SHIELD_EASYSPLIT_LEFT
    def_bool $(shields_list_contains,easysplit_left)

config SHIELD_EASYSPLIT_RIGHT
    def_bool $(shields_list_contains,easysplit_right)
```
